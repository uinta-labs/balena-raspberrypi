## layers/meta-balena-raspberrypi/conf/machine/fincm3.conf
```bitbake
#@TYPE: Machine
#@NAME: Balena Fin (CM3)
#@DESCRIPTION: Machine configuration for Balena Fin board (CM3)

MACHINEOVERRIDES = "raspberrypi3-64:${MACHINE}"
include conf/machine/raspberrypi3-64.conf

MACHINE_ESSENTIAL_EXTRA_RRECOMMENDS += "sd8887-nxp"
```
